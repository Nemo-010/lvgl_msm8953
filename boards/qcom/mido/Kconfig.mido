## boards/qcom/mido/board.yml
```yaml
board:
  name: mido
  full_name: Xiaomi Redmi Note 4 (MSM8953)
  vendor: qcom
  socs:
  - name: msm8953
```

## boards/qcom/mido/mido_defconfig
```kconfig
# SPDX-License-Identifier: Apache-2.0
CONFIG_ARM_ARCH_TIMER=y
CONFIG_CACHE_MANAGEMENT=y
CONFIG_XIP=n
CONFIG_FLASH_SIZE=0
CONFIG_FLASH_BASE_ADDRESS=0x0
CONFIG_MP_MAX_NUM_CPUS=1
CONFIG_SERIAL=y
CONFIG_CONSOLE=y
CONFIG_UART_CONSOLE=y
CONFIG_UART_QCOM_UARTDM=y
CONFIG_DISPLAY=y
CONFIG_DISPLAY_QCOM_MDP5_CONT_SPLASH=y
CONFIG_FWARGS_HANDLER_HOOK=y
```

## drivers/display/Kconfig.qcom_mdp5
```kconfig
# SPDX-License-Identifier: Apache-2.0

config DISPLAY_QCOM_MDP5_CONT_SPLASH
	bool "Qualcomm MDSS MDP5 continuous-splash framebuffer"
	default y
	depends on DT_HAS_QCOM_MDP5_CONT_SPLASH_ENABLED
	depends on DISPLAY
	help
	  Render into the framebuffer that the bootloader's MDSS MDP5 pipeline is
	  still scanning out, instead of initialising a display controller of our
	  own. This avoids writing a full DSI + panel driver: no PLL, no DSI PHY,
	  no panel command sequence.

	  It only works if the MDP is left in self-refreshing mode. lk2nd does
	  that when the kernel command line contains
	  "lk2nd.pass-simplefb=autorefresh", which is what the images built by
	  this repository pass.

config DISPLAY_QCOM_MDP5_LOG_REGISTERS
	bool "Dump the decoded MDP5 pipe configuration at boot"
	depends on DISPLAY_QCOM_MDP5_CONT_SPLASH
	default y
```

## drivers/serial/Kconfig.qcom_uartdm
```kconfig
# SPDX-License-Identifier: Apache-2.0

config UART_QCOM_UARTDM
	bool "Qualcomm UARTDM (BLSP) serial driver"
	default y
	depends on DT_HAS_QCOM_MSM_UARTDM_ENABLED
	select SERIAL_HAS_DRIVER
	help
	  Polled driver for the Qualcomm "UARTDM" block found in the BLSP1
	  peripheral subsystem. It deliberately does not reconfigure the
	  controller: the bootloader (lk2nd) already brought the debug UART up
	  at 115200 8N1 and keeps its clock running, so the driver only pushes
	  characters out of the TX FIFO.

config UART_QCOM_UARTDM_INIT_BAUD
	bool "Program the baud rate divisor during init"
	depends on UART_QCOM_UARTDM
	help
	  Only needed if something before us left the UART in an unknown state.
	  Off by default: touching the divisor means touching the GCC clocks,
	  which lk2nd has already configured correctly.
```

## dts/bindings/display/qcom,mdp5-cont-splash.yaml
```yaml
# SPDX-License-Identifier: Apache-2.0
description: |
  Qualcomm MDSS MDP5 framebuffer left running by the bootloader.

  The driver does not initialise the display controller. It reads the pipe
  registers to find out which surface the bootloader is scanning out, then
  renders into that memory. Requires the bootloader to have the MDP in
  self-refreshing ("autorefresh") mode, which lk2nd enables when the kernel
  command line contains lk2nd.pass-simplefb=autorefresh.

  The geometry (address, size, stride, pixel format) is not described here: it
  is discovered at runtime, either from the device tree lk2nd hands over or
  from the MDP5 registers themselves.

compatible: "qcom,mdp5-cont-splash"

include: display-controller.yaml

properties:
  reg:
    type: array
    required: true
```

## dts/bindings/serial/qcom,msm-uartdm.yaml
```yaml
# SPDX-License-Identifier: Apache-2.0
description: Qualcomm UARTDM (BLSP) serial controller

compatible: "qcom,msm-uartdm"

include: [uart-controller.yaml, pinctrl-device.yaml]

properties:
  reg:
    type: array
    required: true

  current-speed:
    default: 115200
```

## soc/qcom/msm8953/Kconfig
```kconfig
# SPDX-License-Identifier: Apache-2.0

if SOC_MSM8953

config NUM_IRQS
	default 1024

config ARM64_VA_BITS
	default 32

config MAX_XLAT_TABLES
	default 12

config SRAM_BASE_ADDRESS
	hex
	default $(dt_chosen_reg_addr_hex,$(DT_CHOSEN_Z_SRAM))

config SRAM_SIZE
	int
	default $(dt_chosen_reg_size_int,$(DT_CHOSEN_Z_SRAM),0,K)

endif # SOC_MSM8953
```

## soc/qcom/msm8953/Kconfig.defconfig
```kconfig
# SPDX-License-Identifier: Apache-2.0

if SOC_MSM8953

config MAIN_STACK_SIZE
	default 16384

config HEAP_MEM_POOL_SIZE
	default 65536

config SYSTEM_WORKQUEUE_STACK_SIZE
	default 4096

endif # SOC_MSM8953
```

## soc/qcom/msm8953/Kconfig.soc
```kconfig
# SPDX-License-Identifier: Apache-2.0

config SOC_MSM8953
	bool
	select ARM64
	select CPU_CORTEX_A53
	select ARM_ARCH_TIMER
	select SYS_CLOCK_EXISTS
	select ARMV8_A_NS
	select HAS_ARM_SMCCC
	help
	  Qualcomm Snapdragon 625 (MSM8953), 8x Cortex-A53.

config SOC
	default "msm8953" if SOC_MSM8953
```

## zephyr/Kconfig
```kconfig
# SPDX-License-Identifier: Apache-2.0
rsource "../drivers/serial/Kconfig.qcom_uartdm"
rsource "../drivers/display/Kconfig.qcom_mdp5"

config DISPLAY_QCOM_MDP5_CONT_SPLASH_DTB_OVERRIDE
	bool "Prefer the lk2nd simple-framebuffer DT node over MDP5 registers"
	depends on DISPLAY_QCOM_MDP5_CONT_SPLASH
	default y
```
